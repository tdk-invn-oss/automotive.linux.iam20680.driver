## drivers/iio/imu/inv_mpu/Kconfig
```kconfig
#
# inv-mpu-iio driver for Invensense MPU devices
#

config INV_MPU_IIO
	tristate
	select IIO_BUFFER
	select IIO_TRIGGERED_BUFFER

choice
	prompt "Chip name"
	depends on INV_MPU_IIO
	help
	  Select TDK Invensense chip.
	  INV_MPU_IIO_ICM20648, INV_MPU_IIO_ICM20608D, INV_MPU_IIO_ICM20602
	  INV_MPU_IIO_ICM20690, INV_MPU_IIO_IAM20680, INV_MPU_IIO_ICM42600
	  INV_MPU_IIO_ICM43600, INV_MPU_IIO_ICM45600

config INV_MPU_IIO_ICM20648
	bool "ICM20648/ICM20948"
	select CRC32
	help
	  Select here if you want to build a driver for the ICM20648/ICM20948
	  TDK Invensense chip

	  This driver can be built as a module
	  The module will be called inv-mpu-iio.ko

config INV_MPU_IIO_ICM20608D
	bool "ICM20608D/ICM206x9/ICM20789"
	select CRC32
	help
	  Select here if you want to build a driver for the ICM20608D/ICM206x9/ICM20789
	  TDK Invensense chip

	  This driver can be built as a module
	  The module will be called inv-mpu-iio.ko

config INV_MPU_IIO_ICM20602
	bool "ICM20602"
	help
	  Select here if you want to build a driver for the ICM20602
	  TDK Invensense chip

	  This driver can be built as a module
	  The module will be called inv-mpu-iio.ko

config INV_MPU_IIO_ICM20690
	bool "ICM20690"
	help
	  Select here if you want to build a driver for the ICM20690
	  TDK Invensense chip

	  This driver can be built as a module
	  The module will be called inv-mpu-iio.ko

config INV_MPU_IIO_IAM20680
	bool "IAM20680"
	help
	  Select here if you want to build a driver for the IAM20680
	  TDK Invensense chip

	  This driver can be built as a module
	  The module will be called inv-mpu-iio.ko

config INV_MPU_IIO_ICM42600
	bool "ICM42600"
	help
	  Select here if you want to build a driver for the ICM42600
	  TDK Invensense chip

	  This driver can be built as a module
	  The module will be called inv-mpu-iio.ko

config INV_MPU_IIO_ICM43600
	bool "ICM43600"
	help
	  Select here if you want to build a driver for the ICM43600
	  TDK Invensense chip

	  This driver can be built as a module
	  The module will be called inv-mpu-iio.ko

config INV_MPU_IIO_ICM45600
	bool "ICM45600"
	help
	  Select here if you want to build a driver for the ICM45600
	  TDK Invensense chip

	  This driver can be built as a module
	  The module will be called inv-mpu-iio.ko

endchoice

config INV_MPU_IIO_I2C
	tristate "Invensense ICM20xxx devices (I2C)"
	depends on I2C && !INV_MPU6050_IIO
	select INV_MPU_IIO
	help
	  This driver supports Invensense ICM20xxx devices over I2C.
	  This driver can be built as a module.
	  The module will be called
	  inv-mpu-iio-i2c.

config INV_MPU_IIO_SPI
	tristate "Invensense ICM20xxx devices (SPI)"
	depends on SPI_MASTER && !INV_MPU6050_IIO
	select INV_MPU_IIO
	help
	  This driver supports Invensense ICM20xxx devices over SPI.
	  This driver can be built as a module.
	  The module will be called
	  inv-mpu-iio-spi.
```
